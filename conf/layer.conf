## conf/layer.conf
```bitbake
# We have a conf and classes directory, append to BBPATH
BBPATH .= ":${LAYERDIR}"

# We have a recipes directory, add to BBFILES
BBFILES += "${LAYERDIR}/recipes*/*/*.bb ${LAYERDIR}/recipes*/*/*.bbappend"

BBFILE_COLLECTIONS += "meta-safeboot"
BBFILE_PATTERN_meta-safeboot = "^${LAYERDIR}/"
BBFILE_PRIORITY_meta-safeboot = "6"

LAYERDEPENDS_meta-safeboot = "core openembedded-layer efi-secure-boot tpm2"
LAYERSERIES_COMPAT_meta-safeboot = "zeus"
```
